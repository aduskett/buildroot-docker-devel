## example-buildroot-project/my_company/Config.in
```kconfig
# See https://buildroot.org/downloads/manual/manual.html#customize
menu "External packages"
endmenu
```

## example-buildroot-project/my_company/package/Config.in
```kconfig
menu "System packages"
source "$BR2_EXTERNAL_MY_COMPANY_PATH/open-plc-utils-updated/Config.in"
endmenu
```

## example-buildroot-project/my_company/package/open-plc-utils-updated/Config.in
```kconfig
config BR2_PACKAGE_OPEN_PLC_UTILS_UPDATED
	bool "open-plc-utils-updated"
	depends on BR2_USE_MMU # fork()
	help
	  Open version of the Qualcomm Atheros Powerline Toolkit

	  https://github.com/qca/open-plc-utils
```
